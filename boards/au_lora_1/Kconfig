## boards/au_lora_1/Kconfig
```kconfig
# Copyright (c) 2022 Caleb Whiting
#
# This file is subject to the terms and conditions of the GNU Lesser
# General Public License v2.1. See the file LICENSE in the top level
# directory for more details.

config BOARD
    default "au_lora_1" if BOARD_AU_LORA_1

config BOARD_AU_LORA_1
    bool
    default y
    select STM32L031K6

    # Put defined MCU peripherals here (in alphabetical order)
    select HAS_PERIPH_ADC
    select HAS_PERIPH_I2C
    select HAS_PERIPH_PWM
    select HAS_PERIPH_RTC
    select HAS_PERIPH_RTT
    select HAS_PERIPH_SPI
    select HAS_PERIPH_TIMER
    select HAS_PERIPH_UART

    # Put other features for this board (in alphabetical order)
    select BOARD_HAS_LSE if (CPU_FAM_L0 || CPU_FAM_L4) && !BOARD_NUCLEO_L011K4
    select HAS_ARDUINO

    source "$(RIOTBOARD)/common/stm32/Kconfig"
```
